/*
 * Copyright (c) 2022 GEIST
 *
 * SPDX-License-Identifier: MIT
 */

#include "klotz.dtsi"

/ {
	chosen {
		zmk,kscan = &kscan;
	};

	kscan: kscan {
		compatible = "zmk,kscan-gpio-matrix";

		label = "KSCAN";
		diode-direction = "row2col";

		row-gpios
			= <&pro_micro 21 GPIO_ACTIVE_HIGH>
			, <&pro_micro 4  GPIO_ACTIVE_HIGH>
			, <&pro_micro 14 GPIO_ACTIVE_HIGH>
			, <&pro_micro 16 GPIO_ACTIVE_HIGH>
			, <&pro_micro 10  GPIO_ACTIVE_HIGH>
			;

		col-gpios
			= <&pro_micro 19 (GPIO_ACTIVE_HIGH | GPIO_PULL_DOWN)>
			, <&pro_micro 20 (GPIO_ACTIVE_HIGH | GPIO_PULL_DOWN)>
			, <&pro_micro 10 (GPIO_ACTIVE_HIGH | GPIO_PULL_DOWN)>
			, <&pro_micro 6 (GPIO_ACTIVE_HIGH | GPIO_PULL_DOWN)>
			, <&pro_micro 7 (GPIO_ACTIVE_HIGH | GPIO_PULL_DOWN)>
			, <&pro_micro 8 (GPIO_ACTIVE_HIGH | GPIO_PULL_DOWN)>
			;
	};
};